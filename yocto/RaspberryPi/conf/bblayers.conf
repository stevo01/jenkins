## yocto/RaspberryPi/conf/bblayers.conf
```bitbake
# POKY_BBLAYERS_CONF_VERSION is increased each time build/conf/bblayers.conf
# changes incompatibly
POKY_BBLAYERS_CONF_VERSION = "2"

BBPATH = "${TOPDIR}"
YOCTOROOT = "${@os.path.abspath(os.path.join("${TOPDIR}", os.pardir))}"
BBFILES ?= ""

BBLAYERS ?= " \
  ${YOCTOROOT}/meta \
  ${YOCTOROOT}/meta-poky \
  ${YOCTOROOT}/meta-yocto-bsp \
  ${YOCTOROOT}/meta-raspberrypi \
  ${YOCTOROOT}/meta-qt5 \
  ${YOCTOROOT}/meta-security \
  ${YOCTOROOT}/meta-openembedded/meta-networking \
  ${YOCTOROOT}/meta-openembedded/meta-python \  
  ${YOCTOROOT}/meta-openembedded/meta-perl \
  ${YOCTOROOT}/meta-openembedded/meta-oe \
"
```
